## conf/bblayers.conf
```bitbake
POKY_BBLAYERS_CONF_VERSION = "2"

BBPATH = "${TOPDIR}"
BBFILES ?= ""

BBLAYERS ?= " \
  /home/ciqiu/yocto-rpi4/poky/meta \
  /home/ciqiu/yocto-rpi4/poky/meta-poky \
  /home/ciqiu/yocto-rpi4/poky/meta-yocto-bsp \
  /home/ciqiu/yocto-rpi4/meta-raspberrypi \
  /home/ciqiu/yocto-rpi4/meta-openembedded/meta-oe \
  /home/ciqiu/yocto-rpi4/poky/meta-semaforo \
  "
```

## conf/local.conf
```bitbake
MACHINE ??= "raspberrypi4"

DL_DIR ?= "${TOPDIR}/../downloads"
SSTATE_DIR ?= "${TOPDIR}/../sstate-cache"

DISTRO ?= "poky"
PACKAGE_CLASSES ?= "package_rpm"

EXTRA_IMAGE_FEATURES ?= "debug-tweaks ssh-server-openssh"
USER_CLASSES ?= "buildstats"
PATCHRESOLVE = "noop"

BB_DISKMON_DIRS ??= "\
    STOPTASKS,${TMPDIR},1G,100K \
    STOPTASKS,${DL_DIR},1G,100K \
    STOPTASKS,${SSTATE_DIR},1G,100K \
    STOPTASKS,/tmp,100M,100K \
    HALT,${TMPDIR},100M,1K \
    HALT,${DL_DIR},100M,1K \
    HALT,${SSTATE_DIR},100M,1K \
    HALT,/tmp,10M,1K"

PACKAGECONFIG:append:pn-qemu-system-native = " sdl"

DISTRO_FEATURES:append = " systemd"
VIRTUAL-RUNTIME_init_manager = "systemd"

CONF_VERSION = "2"

IMAGE_INSTALL:append = " python3 python3-pip python3-numpy python3-opencv v4l-utils"
```
